## firmware/components/db_board/Kconfig
```kconfig
menu "Deck Connector board"
    choice DB_BOARD
        prompt "Board"
        default DB_BOARD_WAVESHARE_P4_POE_ETH
        config DB_BOARD_WAVESHARE_P4_POE_ETH
            bool "Waveshare ESP32-P4-WIFI6-POE-ETH"
            depends on IDF_TARGET_ESP32P4
        config DB_BOARD_SIM
            bool "Simulator (firmware/simdeck)"
            depends on IDF_TARGET_LINUX
    endchoice
endmenu
```

## firmware/sim/sdkconfig.defaults
```kconfig
CONFIG_IDF_TARGET="linux"
CONFIG_HTTPD_MAX_REQ_HDR_LEN=1024
CONFIG_HTTPD_WS_SUPPORT=y
CONFIG_HTTPD_WS_PRE_HANDSHAKE_CB_SUPPORT=y
CONFIG_HTTPD_WS_POST_HANDSHAKE_CB_SUPPORT=y
CONFIG_LWIP_MAX_SOCKETS=32
```

## firmware/simdeck/sdkconfig.defaults
```kconfig
CONFIG_IDF_TARGET="linux"
CONFIG_FREERTOS_HZ=1000
CONFIG_HTTPD_MAX_REQ_HDR_LEN=8192
CONFIG_HTTPD_WS_SUPPORT=y
CONFIG_HTTPD_WS_PRE_HANDSHAKE_CB_SUPPORT=y
CONFIG_HTTPD_WS_POST_HANDSHAKE_CB_SUPPORT=y
CONFIG_LWIP_MAX_SOCKETS=32
CONFIG_MBEDTLS_X509_CREATE_C=y
CONFIG_MBEDTLS_X509_CRT_WRITE_C=y
CONFIG_PARTITION_TABLE_CUSTOM=y
CONFIG_PARTITION_TABLE_CUSTOM_FILENAME="../sim/partitions.csv"
CONFIG_CJSON_NESTING_LIMIT=16
# The board's mDNS responder over Linux sockets, on DB_SIM_MDNS_IF only
CONFIG_MDNS_NETWORKING_SOCKET=y
CONFIG_MDNS_PREDEF_NETIF_STA=n
CONFIG_MDNS_PREDEF_NETIF_AP=n
CONFIG_MDNS_PREDEF_NETIF_ETH=n
CONFIG_MDNS_MAX_SERVICES=12
CONFIG_MDNS_ENABLE_CONSOLE_CLI=n
```
